#include <SPI.h>
#include <Wire.h>
#include <Adafruit_GFX.h>
#include <Adafruit_SSD1306.h>

// Screen settings
#define SCREEN_WIDTH 128 // OLED display width, in pixels
#define SCREEN_HEIGHT 64 // OLED display height, in pixels
#define OLED_MOSI   9 // D1
#define OLED_CLK   10 // D0
#define OLED_DC    11
#define OLED_CS    12
#define OLED_RESET 13
Adafruit_SSD1306 display(SCREEN_WIDTH, SCREEN_HEIGHT,
  OLED_MOSI, OLED_CLK, OLED_DC, OLED_RESET, OLED_CS);

// Buttons settings
#define rightButton 4
#define leftButton 2
#define okButton 3
#define steamButton 5

// Light buttons settings
#define light_rightButton 28
#define light_leftButton 30
#define light_okButton 32
#define light_waterSensor 34

// Potentiometer settings
#define potentiometerPin A0
#define power_1_End 205
#define power_2_End 410
#define power_3_End 615
#define power_4_End 900

// Alcohol pumps settings
#define alcohol_Pump 52
#define soda_Pump 53

// Time settings
#define button_Check_time 30
#define button_Back_time 150
#define alchol_Time 2500
#define soda_Time 13000
#define shot_Time 5000
#define mediumDrink_alcohol_Time 5000
#define mediumDrink_soda_Time 8000
#define bigDrink_alcohol_Time 8000
#define bigDrink_soda_Time 10000
#define relay_Break_time 1500

int power = 0;

int potentiometer_Value;

// Image of Start screen with logo (128x64)
const unsigned char start_Screen_BitmapBitmap [] PROGMEM = {
  0x00, 0x00, 0x00, 0x00, 0x00, 0x00, 0x00, 0x00, 0x00, 0x00, 0x00, 0x00, 0x00, 0x00, 0x00, 0x00, 
  0x00, 0x00, 0x00, 0x00, 0x00, 0x00, 0x00, 0x00, 0x00, 0x00, 0x00, 0x00, 0x00, 0x00, 0x00, 0x00, 
  0x00, 0x00, 0x00, 0x00, 0x00, 0x00, 0x00, 0x00, 0x00, 0x00, 0x00, 0x00, 0x00, 0x00, 0x00, 0x00, 
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  0x00, 0x00, 0x00, 0x00, 0x00, 0x00, 0x00, 0x00, 0x00, 0x00, 0x00, 0x00, 0x00, 0x00, 0x00, 0x00
};

// Image of "Drink is ready" screen (128x64)

const unsigned char drink_Ready_bitmapBitmap [] PROGMEM = {
  0x00, 0x00, 0x00, 0x00, 0x00, 0x00, 0x00, 0x00, 0x00, 0x00, 0x00, 0x00, 0x7f, 0xff, 0xff, 0xff, 
  0x00, 0x00, 0x00, 0x00, 0x00, 0x00, 0x00, 0x00, 0x00, 0x00, 0x00, 0x3e, 0x7f, 0xff, 0xff, 0xff, 
  0x00, 0x00, 0x00, 0x00, 0x00, 0x00, 0x00, 0x00, 0x00, 0x00, 0x1f, 0xfe, 0x3f, 0xff, 0xff, 0xff, 
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  0x00, 0x00, 0x00, 0x00, 0x00, 0x00, 0x00, 0x00, 0x00, 0x00, 0x00, 0x00, 0x00, 0x00, 0x00, 0x00
};

// Image of alcohol power 1 (128x64)
const unsigned char level_1_BitmapBitmap [] PROGMEM = {
  0xff, 0xff, 0xff, 0xff, 0xff, 0xff, 0xff, 0xff, 0xff, 0xff, 0xff, 0xff, 0xff, 0xff, 0xff, 0xff, 
  0xff, 0xff, 0xff, 0xff, 0xff, 0xff, 0xff, 0xff, 0xff, 0xff, 0xff, 0xff, 0xff, 0xff, 0xff, 0xff, 
  0xc0, 0x00, 0x00, 0x00, 0x00, 0x00, 0x00, 0x00, 0x00, 0x00, 0x00, 0x00, 0x00, 0x00, 0x00, 0x03, 
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  0xff, 0xff, 0xff, 0xff, 0xff, 0xff, 0xff, 0xff, 0xff, 0xff, 0xff, 0xff, 0xff, 0xff, 0xff, 0xff
};

// Image of alcohol power 2 (128x64)
const unsigned char level_2_BitmapBitmap [] PROGMEM = {
0xff, 0xff, 0xff, 0xff, 0xff, 0xff, 0xff, 0xff, 0xff, 0xff, 0xff, 0xff, 0xff, 0xff, 0xff, 0xff, 
  0xff, 0xff, 0xff, 0xff, 0xff, 0xff, 0xff, 0xff, 0xff, 0xff, 0xff, 0xff, 0xff, 0xff, 0xff, 0xff, 
  0xc0, 0x00, 0x00, 0x00, 0x00, 0x00, 0x00, 0x00, 0x00, 0x00, 0x00, 0x00, 0x00, 0x00, 0x00, 0x03, 
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  0xff, 0xff, 0xff, 0xff, 0xff, 0xff, 0xff, 0xff, 0xff, 0xff, 0xff, 0xff, 0xff, 0xff, 0xff, 0xff
};

// Image of alcohol power 3 (128x64)
const unsigned char level_3_BitmapBitmap [] PROGMEM = {
  0xff, 0xff, 0xff, 0xff, 0xff, 0xff, 0xff, 0xff, 0xff, 0xff, 0xff, 0xff, 0xff, 0xff, 0xff, 0xff, 
  0xff, 0xff, 0xff, 0xff, 0xff, 0xff, 0xff, 0xff, 0xff, 0xff, 0xff, 0xff, 0xff, 0xff, 0xff, 0xff, 
  0xc0, 0x00, 0x00, 0x00, 0x00, 0x00, 0x00, 0x00, 0x00, 0x00, 0x00, 0x00, 0x00, 0x00, 0x00, 0x03, 
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  0xff, 0xff, 0xff, 0xff, 0xff, 0xff, 0xff, 0xff, 0xff, 0xff, 0xff, 0xff, 0xff, 0xff, 0xff, 0xff
};

// Image of alcohol power 4 (128x64)
const unsigned char level_4_BitmapBitmap [] PROGMEM = {
  0xff, 0xff, 0xff, 0xff, 0xff, 0xff, 0xff, 0xff, 0xff, 0xff, 0xff, 0xff, 0xff, 0xff, 0xff, 0xff, 
  0xff, 0xff, 0xff, 0xff, 0xff, 0xff, 0xff, 0xff, 0xff, 0xff, 0xff, 0xff, 0xff, 0xff, 0xff, 0xff, 
  0xc0, 0x00, 0x00, 0x00, 0x00, 0x00, 0x00, 0x00, 0x00, 0x00, 0x00, 0x00, 0x00, 0x00, 0x00, 0x03, 
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  0xff, 0xff, 0xff, 0xff, 0xff, 0xff, 0xff, 0xff, 0xff, 0xff, 0xff, 0xff, 0xff, 0xff, 0xff, 0xff
};

// Image of alcohol power 5 (128x64)
const unsigned char level_5_BitmapBitmap [] PROGMEM = {
  0xff, 0xff, 0xff, 0xff, 0xff, 0xff, 0xff, 0xff, 0xff, 0xff, 0xff, 0xff, 0xff, 0xff, 0xff, 0xff, 
  0xff, 0xff, 0xff, 0xff, 0xff, 0xff, 0xff, 0xff, 0xff, 0xff, 0xff, 0xff, 0xff, 0xff, 0xff, 0xff, 
  0xc0, 0x00, 0x00, 0x00, 0x00, 0x00, 0x00, 0x00, 0x00, 0x00, 0x00, 0x00, 0x00, 0x00, 0x00, 0x03, 
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  0xff, 0xff, 0xff, 0xff, 0xff, 0xff, 0xff, 0xff, 0xff, 0xff, 0xff, 0xff, 0xff, 0xff, 0xff, 0xff
};

void setup()
{

  Serial.begin(9600);
  display.begin(SSD1306_SWITCHCAPVCC);
  

  pinMode(rightButton, INPUT_PULLUP);
  pinMode(leftButton, INPUT_PULLUP);
  pinMode(okButton, INPUT_PULLUP);
  pinMode(steamButton, INPUT_PULLUP);
  pinMode(potentiometerPin, INPUT);

  pinMode(alcohol_Pump, OUTPUT);
  pinMode(soda_Pump, OUTPUT);
  
  pinMode(light_rightButton, OUTPUT);
  pinMode(light_leftButton, OUTPUT);
  pinMode(light_okButton, OUTPUT);
  pinMode(light_waterSensor, OUTPUT);

  digitalWrite(alcohol_Pump, HIGH);
  digitalWrite(soda_Pump, HIGH);

  Serial.println("*****ALKOMAT COMPACT V0.0.1");
  Serial.println("");
  
}

bool is_Button_pressed(int button)
{

  if (digitalRead(button) == LOW)
  {

    delay(button_Check_time);

    if (digitalRead(button) == LOW)
    {
      return true;
    }
  }

  return false;
}

void start()
{

  //Press any button to start

  display.clearDisplay();
  display.drawBitmap(0, 0, start_Screen_BitmapBitmap, SCREEN_WIDTH, SCREEN_HEIGHT, WHITE);
  display.display();

  digitalWrite(light_rightButton, HIGH);
  digitalWrite(light_leftButton, HIGH);
  digitalWrite(light_okButton, HIGH);
  digitalWrite(light_waterSensor, HIGH);

  Serial.println("[ALKOMAT IS RUNNING...]");
}

void modeSelection(){

// Display on the screen "Alkomat is ready to serve"

while (!is_Button_pressed(okButton) && !is_Button_pressed(rightButton) && !is_Button_pressed(leftButton) && !is_Button_pressed(steamButton))
  {
  }

if(is_Button_pressed(steamButton)){

Serial.println("[SELECTED MODE: CUSTOM DRINK]");
power_Select();

} 
if(is_Button_pressed(rightButton)){

Serial.println("[SELECTED MODE: SHOT]");
shotMode();

} 
if(is_Button_pressed(okButton)){

Serial.println("[SELECTED MODE: MEDIUM DRINK]");
mediumDrink_mode();

} 
if(is_Button_pressed(leftButton)){

Serial.println("[SELECTED MODE: BIG DRINK]");
bigDrink_mode();

} 

}

void shotMode(){ // SHOT MODE

Serial.println("[MAKING DRINK...]\n");

digitalWrite(light_rightButton, HIGH);
digitalWrite(light_okButton, LOW);
digitalWrite(light_leftButton, LOW);

digitalWrite(alcohol_Pump, LOW);
delay(shot_Time);
digitalWrite(alcohol_Pump, HIGH);

Serial.println("[ALCOHOL INSERTED]");
Serial.println("Drink is done...");
Serial.println("\n\n");

delay(relay_Break_time);

digitalWrite(light_rightButton, HIGH);
digitalWrite(light_leftButton, HIGH);
digitalWrite(light_okButton, HIGH);

}

void mediumDrink_mode(){  // MEDIUM DRINK MODE

Serial.println("[MAKING DRINK...]\n");

digitalWrite(light_rightButton, LOW);
digitalWrite(light_okButton, HIGH);
digitalWrite(light_leftButton, LOW);

digitalWrite(alcohol_Pump, LOW);
delay(mediumDrink_alcohol_Time);
digitalWrite(alcohol_Pump, HIGH);

Serial.println("[ALCOHOL INSERTED]");

delay(relay_Break_time);

digitalWrite(soda_Pump, LOW);
delay(mediumDrink_soda_Time);
digitalWrite(soda_Pump, HIGH);

digitalWrite(light_rightButton, HIGH);
digitalWrite(light_okButton, HIGH);
digitalWrite(light_leftButton, HIGH);

delay(relay_Break_time);

Serial.println("[SODA INSERTED]");
Serial.println("Drink is done...");
Serial.println("\n\n");
}

void bigDrink_mode(){ // BIG DRINK MODE

Serial.println("[MAKING DRINK...]\n");

digitalWrite(light_leftButton, HIGH);
digitalWrite(light_okButton, LOW);
digitalWrite(light_rightButton, LOW);

digitalWrite(alcohol_Pump, LOW);
delay(bigDrink_alcohol_Time);
digitalWrite(alcohol_Pump, HIGH);

Serial.println("[ALCOHOL INSERTED]");

delay(relay_Break_time);

digitalWrite(soda_Pump, LOW);
delay(bigDrink_soda_Time);
digitalWrite(soda_Pump, HIGH);

digitalWrite(light_rightButton, HIGH);
digitalWrite(light_okButton, HIGH);
digitalWrite(light_leftButton, HIGH);

delay(relay_Break_time);

Serial.println("[SODA INSERTED]");
Serial.println("Drink is done...");
Serial.println("\n\n");

}

int power_Display(int power){

  display.clearDisplay();

if(power == 1){

display.drawBitmap(0, 0, level_1_BitmapBitmap, SCREEN_WIDTH, SCREEN_HEIGHT, WHITE);
display.display();

} 

if(power == 2){

display.drawBitmap(0, 0, level_2_BitmapBitmap, SCREEN_WIDTH, SCREEN_HEIGHT, WHITE);
display.display();

} 

if(power == 3){

display.drawBitmap(0, 0, level_3_BitmapBitmap, SCREEN_WIDTH, SCREEN_HEIGHT, WHITE);
display.display();

} 

if(power == 4){

display.drawBitmap(0, 0, level_4_BitmapBitmap, SCREEN_WIDTH, SCREEN_HEIGHT, WHITE);
display.display();

} 

if(power == 5){

display.drawBitmap(0, 0, level_5_BitmapBitmap, SCREEN_WIDTH, SCREEN_HEIGHT, WHITE);
display.display();

} 

}

void potentiometer_Status(){

potentiometer_Value = analogRead(potentiometerPin);

delay(500);


}

void power_Select()
{
  delay(button_Back_time);

  while (!is_Button_pressed(steamButton))
  {

    potentiometer_Status();

    if(potentiometer_Value < power_1_End){ //  power is 1

      // Power of alcohol in drink is 1
      power = 1;

      power_Display(power);

    }

    if(potentiometer_Value > power_1_End && potentiometer_Value < power_2_End){ //  power is 2

      // Power of alcohol in drink is 2
      power = 2;

      power_Display(power);

    }

    if(potentiometer_Value > power_2_End && potentiometer_Value < power_3_End){ //  power is 3

      // Power of alcohol in drink is 3
      power = 3;

      power_Display(power);

    }

    if(potentiometer_Value > power_3_End && potentiometer_Value < power_4_End){ //  power is 4

      // Power of alcohol in drink is 4
      power = 4;

      power_Display(power);

    }

    if(potentiometer_Value > power_4_End){ //  power is 5

      // Power of alcohol in drink is 5
      power = 5;

      power_Display(power);

    }
    
  }

power_Info();
  make_Drink();

}

void power_Info() // Prints information about value of power and print if on serial port
{

  Serial.print("[POWER OF DRINK: ");
  Serial.print(power);
  Serial.print("]");
}

void make_Drink() // Selects the right acohol power program
{

  int alcohol_Pump_time, soda_Pump_time;

  alcohol_Pump_time = alchol_Time * power;
  soda_Pump_time = soda_Time - (alcohol_Pump_time);

  Serial.println("\n[MAKING DRINK...]\n");
  // Display on the screen "Making cocktail in progress..."

  digitalWrite(light_rightButton, LOW);
digitalWrite(light_okButton, LOW);
digitalWrite(light_leftButton, LOW);

  digitalWrite(alcohol_Pump, LOW);
  delay(alcohol_Pump_time);
  digitalWrite(alcohol_Pump, HIGH);

  Serial.println("[ALCOHOL INSERTED]");

  delay(relay_Break_time);

  digitalWrite(soda_Pump, LOW);
  delay(soda_Pump_time);
  digitalWrite(soda_Pump, HIGH);

  Serial.println("[SODA INSERTED]");

  delay(relay_Break_time);

  digitalWrite(light_rightButton, HIGH);
digitalWrite(light_okButton, HIGH);
digitalWrite(light_leftButton, HIGH);

  Serial.println("Drink is done...");
  Serial.println("\n\n");

  // Display on the screen "Your cocktail is done. Cheers !"

  display.clearDisplay();
  display.drawBitmap(0, 0, drink_Ready_bitmapBitmap, SCREEN_WIDTH, SCREEN_HEIGHT, WHITE);
  display.display();

  delay(5000);

}

void loop()
{

  start();
  modeSelection();

  power = 1;

  delay(button_Back_time);

  display.clearDisplay();
}
